## dts/bindings/input/cirque,pinnacle.yaml
```yaml
# Copyright (c) 2022 The ZMK Contributors
# SPDX-License-Identifier: MIT

description: Cirque Pinnacle Trackpad

compatible: "cirque,pinnacle"

include: [spi-device.yaml, i2c-device.yaml]

properties:
  dr-gpios:
    type: phandle-array
    description: |
      GPIO connected to the Data Ready (DR) pin.
      Required for interrupt-driven operation and Wake-on-Touch.

  sensitivity:
    type: string
    enum:
      - "1x"
      - "2x"
      - "3x"
      - "4x"
    default: "1x"
    description: |
      ADC sensitivity multiplier.
      Higher values increase tracking sensitivity but may introduce noise.

  x-axis-z-min:
    type: int
    default: 0
    description: |
      Edge sensitivity for X axis (0-31).
      Lower values make it easier to detect touches near the perimeter.

  y-axis-z-min:
    type: int
    default: 0
    description: |
      Edge sensitivity for Y axis (0-31).
      Lower values make it easier to detect touches near the perimeter.

  sleep:
    type: boolean
    description: |
      Enable hardware sleep mode.
      When enabled, the device will enter low-power sleep after idle timeout.
      Use with CONFIG_ZMK_INPUT_PINNACLE_IDLE_SLEEPER for activity-based control.

  no-taps:
    type: boolean
    description: |
      Disable all tap detection.

  no-secondary-tap:
    type: boolean
    description: |
      Disable secondary (right-click) tap detection only.

  rotate-90:
    type: boolean
    description: |
      Rotate trackpad orientation by 90 degrees.

  x-invert:
    type: boolean
    description: |
      Invert X axis direction.

  y-invert:
    type: boolean
    description: |
      Invert Y axis direction.

  curved-overlay:
    type: boolean
    description: |
      Enable compensation for curved overlay material.
```

## modules/cirque-input-module/drivers/input/Kconfig
```kconfig
# Copyright (c) 2022 The ZMK Contributors
# SPDX-License-Identifier: MIT

menuconfig INPUT_PINNACLE
	bool "Cirque Pinnacle Trackpad"
	default y
	depends on DT_HAS_CIRQUE_PINNACLE_ENABLED
	depends on GPIO
	depends on SPI || I2C
	depends on INPUT
	help
	  Enable driver for Cirque Pinnacle trackpad

if INPUT_PINNACLE

config INPUT_PINNACLE_INIT_PRIORITY
	int "Init priority"
	default INPUT_INIT_PRIORITY
	help
	  Pinnacle device driver initialization priority.

config ZMK_INPUT_PINNACLE_IDLE_SLEEPER
	bool "Enable ZMK idle-linked sleep for Pinnacle"
	default n
	depends on ZMK_POINTING
	help
	  Enable automatic sleep/wake for Pinnacle based on ZMK activity state.

config ZMK_INPUT_PINNACLE_WAKE_ON_TOUCH
	bool "Enable Wake-on-Touch optimization"
	default y
	depends on ZMK_INPUT_PINNACLE_IDLE_SLEEPER
	help
	  Keep DR GPIO interrupt enabled during sleep for instant wake-on-touch.
	  This reduces wake latency significantly.

config ZMK_INPUT_PINNACLE_FAST_WAKE
	bool "Enable fast wake mode (skip calibration on resume)"
	default y
	depends on ZMK_INPUT_PINNACLE_IDLE_SLEEPER
	help
	  Skip calibration and use minimal initialization on wake for faster response.

endif # INPUT_PINNACLE
```
