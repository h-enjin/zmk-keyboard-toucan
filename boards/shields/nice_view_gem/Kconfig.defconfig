## boards/shields/nice_view_gem/Kconfig.defconfig
```kconfig
if SHIELD_NICE_VIEW_GEM

config LV_Z_VDB_SIZE
    default 100

config LV_DPI_DEF
    default 161

config LV_Z_BITS_PER_PIXEL
    default 1

choice LV_COLOR_DEPTH
    default LV_COLOR_DEPTH_1
endchoice

choice ZMK_DISPLAY_WORK_QUEUE
    default ZMK_DISPLAY_WORK_QUEUE_DEDICATED
endchoice

choice ZMK_DISPLAY_STATUS_SCREEN
    default ZMK_DISPLAY_STATUS_SCREEN_CUSTOM
endchoice

config LV_Z_MEM_POOL_SIZE
    default 4096 if ZMK_DISPLAY_STATUS_SCREEN_CUSTOM

config ZMK_DISPLAY_STATUS_SCREEN_CUSTOM
    imply NICE_VIEW_WIDGET_STATUS

config NICE_VIEW_WIDGET_STATUS
    select LV_USE_LABEL
    select LV_USE_IMG
    select LV_USE_CANVAS
    select LV_USE_ANIMIMG
    select LV_USE_ANIMATION

config NICE_VIEW_WIDGET_INVERTED
    bool "Invert display colors"

config NICE_VIEW_BLE_PROFILE_0_NAME
    string "BLE Profile 0 display name"
    default ""
    help
      Display name for BLE profile 0. Max 4 characters recommended.
      Leave empty to hide.

config NICE_VIEW_BLE_PROFILE_1_NAME
    string "BLE Profile 1 display name"
    default ""
    help
      Display name for BLE profile 1. Max 4 characters recommended.
      Leave empty to hide.

config NICE_VIEW_BLE_PROFILE_2_NAME
    string "BLE Profile 2 display name"
    default ""
    help
      Display name for BLE profile 2. Max 4 characters recommended.
      Leave empty to hide.

config NICE_VIEW_BLE_PROFILE_3_NAME
    string "BLE Profile 3 display name"
    default ""
    help
      Display name for BLE profile 3. Max 4 characters recommended.
      Leave empty to hide.

config NICE_VIEW_BLE_PROFILE_4_NAME
    string "BLE Profile 4 display name"
    default ""
    help
      Display name for BLE profile 4. Max 4 characters recommended.
      Leave empty to hide.

if !ZMK_SPLIT || ZMK_SPLIT_ROLE_CENTRAL

config NICE_VIEW_WIDGET_STATUS
    select ZMK_WPM

endif # !ZMK_SPLIT || ZMK_SPLIT_ROLE_CENTRAL

endif # SHIELD_NICE_VIEW_GEM
```

## config/west.yml
```yaml
manifest:
  defaults:
    revision: v0.3
  remotes:
    - name: zmkfirmware
      url-base: https://github.com/zmkfirmware
    - name: petejohanson
      url-base: https://github.com/petejohanson/
    - name: caksoylar
      url-base: https://github.com/caksoylar
    - name: geeksville
      url-base: https://github.com/geeksville
    - name: prospector
      url-base: https://github.com/t-ogura
  projects:
    - name: zmk
      remote: zmkfirmware
      import: app/west.yml
    - name: cirque-input-module
      remote: geeksville
      revision: toucan
    - name: zmk-rgbled-widget
      remote: caksoylar
      revision: v0.3
    - name: prospector-zmk-module
      remote: prospector
      revision: v1.0.0
      path: modules/prospector-zmk-module
  self:
    path: config
```
